## security/kttech/Kconfig
```kconfig
config SECURITY_KTTECH
	bool "KTTech LSM"
	depends on SECURITY
	default n
	help
	  This selects the KTTech LSM.
	  If you are unsure how to answer this question, answer N.
```
